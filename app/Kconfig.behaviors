## app/Kconfig.behaviors
```kconfig
# Copyright (c) 2023 The ZMK Contributors
# SPDX-License-Identifier: MIT

config ZMK_BEHAVIOR_METADATA
    bool "Metadata"
    help
      Enabling this option adds APIs for documenting and fetching
      metadata describing a behaviors name, and supported parameters.

config ZMK_BEHAVIOR_LOCAL_IDS
    bool "Local IDs"

if ZMK_BEHAVIOR_LOCAL_IDS

config ZMK_BEHAVIOR_LOCAL_IDS_IN_BINDINGS
    bool "Track in behavior bindings"

choice ZMK_BEHAVIOR_LOCAL_ID_TYPE
    prompt "Local ID Type"

config ZMK_BEHAVIOR_LOCAL_ID_TYPE_SETTINGS_TABLE
    bool "Settings Table"
    depends on SETTINGS
    select ZMK_BEHAVIOR_LOCAL_IDS_IN_BINDINGS
    help
      Use persistent entries in the settings subsystem to identify
      behaviors by local ID, which uses the device name to generate
      a new settings entry tying a presistant local ID to that name.
      This guarantees stable, colllision-free local IDs at the expense
      of settings storage used.

config ZMK_BEHAVIOR_LOCAL_ID_TYPE_CRC16
    bool "CRC16 Hash"
    select CRC
    help
      Use the CRC16-ANSI hash of behavior device names to generate
      stable behavior local IDs. This saves on settings storage at
      the expense of (highly unlikely) risk of collisions.

endchoice

endif


config ZMK_BEHAVIOR_HOLD_TAP
    bool
    default y
    depends on DT_HAS_ZMK_BEHAVIOR_HOLD_TAP_ENABLED

if ZMK_BEHAVIOR_HOLD_TAP

config ZMK_BEHAVIOR_HOLD_TAP_MAX_HELD
    int "Hold Tap Max Held"
    help
      Max number of simultaneously held hold-taps

config ZMK_BEHAVIOR_HOLD_TAP_MAX_CAPTURED_EVENTS
    int "Hold Tap Max Captured Events"
    help
      Max number of captured system events while waiting to resolve hold taps

endif

config ZMK_BEHAVIOR_KEY_TOGGLE
    bool
    default y
    depends on DT_HAS_ZMK_BEHAVIOR_KEY_TOGGLE_ENABLED

config ZMK_BEHAVIOR_MOUSE_KEY_PRESS
    bool
    default y
    depends on DT_HAS_ZMK_BEHAVIOR_MOUSE_KEY_PRESS_ENABLED && ZMK_POINTING

config ZMK_BEHAVIOR_STICKY_KEY
    bool
    default y
    depends on DT_HAS_ZMK_BEHAVIOR_STICKY_KEY_ENABLED

if ZMK_BEHAVIOR_STICKY_KEY

config ZMK_BEHAVIOR_STICKY_KEY_MAX_HELD
    int "Sticky Key Max Held"
    help
      Max number of simultaneously held sticky keys

endif

config ZMK_BEHAVIOR_SOFT_OFF
    bool
    default y
    depends on DT_HAS_ZMK_BEHAVIOR_SOFT_OFF_ENABLED && ZMK_PM_SOFT_OFF


config ZMK_BEHAVIOR_TAP_DANCE
    bool
    default y
    depends on DT_HAS_ZMK_BEHAVIOR_TAP_DANCE_ENABLED

if ZMK_BEHAVIOR_TAP_DANCE

config ZMK_BEHAVIOR_TAP_DANCE_MAX_HELD
    int "Tap-Dance Max Held"
    help
      Max number of simultaneously held taps-dances

endif

config ZMK_BEHAVIOR_INPUT_TWO_AXIS
    bool
    default y
    depends on DT_HAS_ZMK_BEHAVIOR_INPUT_TWO_AXIS_ENABLED && ZMK_POINTING

config ZMK_BEHAVIOR_SENSOR_ROTATE_COMMON
    bool

config ZMK_BEHAVIOR_SENSOR_ROTATE
    bool
    default y
    depends on DT_HAS_ZMK_BEHAVIOR_SENSOR_ROTATE_ENABLED
    select ZMK_BEHAVIOR_SENSOR_ROTATE_COMMON

config ZMK_BEHAVIOR_SENSOR_ROTATE_VAR
    bool
    default y
    depends on DT_HAS_ZMK_BEHAVIOR_SENSOR_ROTATE_VAR_ENABLED
    select ZMK_BEHAVIOR_SENSOR_ROTATE_COMMON

config ZMK_BEHAVIOR_STUDIO_UNLOCK
    bool
    default y
    depends on DT_HAS_ZMK_BEHAVIOR_STUDIO_UNLOCK_ENABLED && ZMK_STUDIO

config ZMK_BEHAVIOR_MACRO
    bool
    default y
    depends on DT_HAS_ZMK_BEHAVIOR_MACRO_ENABLED || DT_HAS_ZMK_BEHAVIOR_MACRO_ONE_PARAM_ENABLED || DT_HAS_ZMK_BEHAVIOR_MACRO_TWO_PARAM_ENABLED

config CONDUCTOR_OS_PROFILE
    bool "Conductor per-profile keymap overlay"
    default n
    help
      Assigns an overlay keymap layer to each output endpoint (USB / BLE
      profile). When an endpoint becomes the selected output the overlay layer
      is activated on top of the shared keymap (and the previous one
      deactivated), giving each device its own keymap where it differs while
      &trans positions inherit the shared layers. When disabled (or with every
      entry 0) the endpoint listener is inert and the keymap is unchanged.

config CONDUCTOR_OS_PROFILE_DEFAULT_ON
    bool "Per-profile keymap overlay enabled by default"
    default n
    depends on CONDUCTOR_OS_PROFILE
    help
      Initial runtime-enable state for the per-profile keymap overlay when no
      persisted setting exists. A value saved over the Studio RPC
      (set_os_config) overrides this default on subsequent boots. With the
      overlay map all-zero this has no effect on the keymap.

config CONDUCTOR_GESTURE_PROFILE
    bool "Conductor per-device trackball gesture overrides"
    default n
    help
      Adds a per-output-endpoint (USB / BLE profile) override table for the
      trackball gesture processor, so the same swipe can emit an OS-appropriate
      shortcut depending on which device is the current output. Configured over
      the Studio gesture RPC subsystem and persisted to settings. When disabled,
      or for any direction with no override set, the gesture processor uses the
      shared gesture layer (13) default exactly as before.

config CONDUCTOR_KEY_REPEAT
    bool "Conductor host-independent key auto-repeat (typematic)"
    default n
    help
      When enabled at runtime (via the Studio pointing RPC), the central
      synthesizes discrete release/press HID report pairs for the most recently
      pressed non-modifier keyboard-page key while it is held, after an initial
      delay and then at a fixed interval. This makes the host see repeated
      keypresses regardless of its own key-repeat settings (works around macOS
      press-and-hold suppressing letter repeat). Central-only. Ships disabled;
      the runtime enable/delay/interval are persisted by the pointing subsystem.

config CONDUCTOR_KEY_REPEAT_DELAY_MS
    int "Key auto-repeat initial delay (ms)"
    default 300
    depends on CONDUCTOR_KEY_REPEAT
    help
      Delay from key press to the first synthesized repeat. Used as the default
      when the persisted/runtime value is 0. Clamped to 100-2000 on apply.

config CONDUCTOR_KEY_REPEAT_INTERVAL_MS
    int "Key auto-repeat interval (ms)"
    default 40
    depends on CONDUCTOR_KEY_REPEAT
    help
      Interval between synthesized repeats after the initial delay. Used as the
      default when the persisted/runtime value is 0. Clamped to 10-200 on apply.
```

## app/dts/bindings/behaviors/zmk,behavior-aml-toggle.yaml
```yaml
# Copyright (c) 2026 The Conductor Contributors
# SPDX-License-Identifier: MIT

description: Auto Mouse Layer (AML) enable/disable toggle behavior

compatible: "zmk,behavior-aml-toggle"

include: zero_param.yaml
```

## app/dts/bindings/input/zmk,input-processor-studio-accel.yaml
```yaml
# Copyright (c) 2025 The Conductor Contributors
# SPDX-License-Identifier: MIT

description: |
  Dynamic pointer-acceleration input processor for ZMK Studio.
  Reads acceleration parameters from runtime variables set by the
  pointing subsystem RPC handler, enabling real-time cursor
  acceleration adjustment from Conductor Studio.

compatible: "zmk,input-processor-studio-accel"

include: base.yaml

properties:
  "#input-processor-cells":
    type: int
    required: true
    const: 0
  type:
    type: int
    default: 0x02  # INPUT_EV_REL
  codes:
    type: array
    required: true
  track-remainders:
    type: boolean
    description: |
      Required by the input-listener (input_listener.c reads track_remainders on
      every processor via DT_PROP). This processor keeps its own per-axis
      remainder accumulator, so leave it unset (false) — declared only so the
      property exists for the listener's macro expansion.
  bypass-layer:
    type: int
    default: -1
    description: |
      Layer index that disables acceleration while active (e.g. the precision
      layer). Set to -1 (default) to never bypass.

input-processor-cells:
  []
```

## app/dts/bindings/input_processors/zmk,input-processor-axis-lock.yaml
```yaml
# Copyright (c) 2026 The ZMK Contributors
# SPDX-License-Identifier: MIT

description: Input processor that locks scrolling to the dominant axis

compatible: "zmk,input-processor-axis-lock"

include: ip_zero_param.yaml

properties:
  type:
    type: int
  wheel-code:
    type: int
  hwheel-code:
    type: int
  activate-threshold:
    type: int
  release-ms:
    type: int
```

## app/dts/bindings/input_processors/zmk,input-processor-gestures.yaml
```yaml
# Copyright (c) 2026 The ZMK Contributors
# SPDX-License-Identifier: MIT

description: Input processor for turning relative XY movement into directional behavior taps

compatible: "zmk,input-processor-gestures"

include: ip_zero_param.yaml

properties:
  type:
    type: int
  x-code:
    type: int
  y-code:
    type: int
  threshold:
    type: int
  timeout-ms:
    type: int
  cooldown-ms:
    type: int
  tap-ms:
    type: int
  layer-id:
    type: int
    required: true
  positions:
    type: array
    required: true
```

## app/src/split/Kconfig
```kconfig
# Copyright (c) 2022 The ZMK Contributors
# SPDX-License-Identifier: MIT

menuconfig ZMK_SPLIT
    bool "Split keyboard support"

if ZMK_SPLIT

config ZMK_SPLIT_ROLE_CENTRAL
    bool "Split central device"

config ZMK_SPLIT_BLE
    bool "BLE Split"
    default y
    depends on ZMK_BLE
    select BT_USER_PHY_UPDATE
    # Keep the split default, but let boards disable host-initiated PHY updates.
    imply BT_AUTO_PHY_UPDATE

config ZMK_SPLIT_WIRED
    bool "Wired Split"
    default y
    depends on DT_HAS_ZMK_WIRED_SPLIT_ENABLED
    select SERIAL
    select RING_BUFFER
    select CRC

config ZMK_SPLIT_PERIPHERAL_HID_INDICATORS
    bool "Peripheral HID Indicators"
    depends on ZMK_HID_INDICATORS
    help
      Enable propagating the HID (LED) Indicator state to the split peripheral(s).

config ZMK_SPLIT_PERIPHERAL_LAYER_STATE
    bool "Peripheral Layer State"
    help
      Propagate the active keymap layer index from the central to the split
      peripheral(s), so a peripheral RGB LED can reflect the current layer.

endif # ZMK_SPLIT

rsource "bluetooth/Kconfig"
rsource "wired/Kconfig"
```
